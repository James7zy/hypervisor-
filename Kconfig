## hypervisor/arch/arm64/Kconfig
```kconfig
choice
    prompt "Target board"
    default BOARD_QEMU_VIRT
config BOARD_QEMU_VIRT
    bool "QEMU virt"
    depends on ARCH_ARM64
config BOARD_RK3588
    bool "Rockchip RK3588 (placeholder, M4)"
    depends on ARCH_ARM64
endchoice
```

## hypervisor/arch/x86/Kconfig
```kconfig
choice
    prompt "Target board"
    default BOARD_STUB
config BOARD_STUB
    bool "Link-check stub (never run)"
    depends on ARCH_X86
endchoice
```
